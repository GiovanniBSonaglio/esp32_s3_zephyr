## drivers/stepper/Kconfig
```kconfig
menu "Stepper Driver Settings"

config STEPPER_FULL_STEPS_PER_REV
        int "Stepper Full steps per Revolution"
        default 200
        help
          Number of steps per revolution for the stepper.

endmenu
```

## drivers/uart/Kconfig
```kconfig
menu "UART Driver Settings"

config UART_RX_BUFFER_SZ
        int "UART Rx Ring Buffer Size"
        default 256
        help
          Size in bytes for UART Rx Ring Buffer.

config UART_TX_BUFFER_SZ
        int "UART Tx Ring Buffer Size"
        default 256
        help
          Size in bytes for UART Tx Ring Buffer.

endmenu
```
